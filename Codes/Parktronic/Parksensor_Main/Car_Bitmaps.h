#ifndef CAR_BITMAPS_H
#define CAR_BITMAPS_H

// ---------------------------------------------------------------------------
// VW Golf III - vereinfachte Draufsicht, Front UNTEN.
// Extrem speichersparend fuer den Arduino Uno:
//   * halbe Aufloesung: jedes gespeicherte Pixel wird als 2x2 Block gezeichnet
//   * nur die linke Haelfte wird gespeichert, die rechte wird gespiegelt
//   * Lauflaengenkodierung (RLE) je Zeile, beginnend mit einem Leer-Lauf
//
// Zonen:  0 vorne links | 1 vorne Mitte | 2 vorne rechts
//         3 hinten links | 4 hinten Mitte | 5 hinten rechts
// ---------------------------------------------------------------------------

#include <Arduino.h>
#include <Adafruit_GFX.h>

#define CAR_S        2                 // Vergroesserungsfaktor
#define CAR_WH       109                // Breite in gespeicherten Pixeln
#define CAR_HH       236                // Hoehe in gespeicherten Pixeln
#define CAR_OFFSET_X 51
#define CAR_OFFSET_Y 4
#define CAR_X1       34                // Grenze links | Mitte (Halbspalten)
#define CAR_X2       75                // Grenze Mitte | rechts
#define CAR_YSPLIT   114                // Grenze hinten | vorne (Halbzeilen)

// REAR_SIDE: 962 Bytes
static const uint8_t PIECE_REAR_SIDE[] PROGMEM = {
  34,34,22,12,15,19,12,22,11,23,10,24,10,22,2,9,9,1,8,7,9,16,9,9,5,1,8,6,
  5,9,11,2,12,9,9,2,7,6,1,8,5,1,4,1,3,12,8,5,1,3,2,2,13,8,8,4,
  1,13,8,8,4,2,12,8,3,2,1,1,2,3,2,12,7,4,4,3,3,2,11,7,4,4,3,3,
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  1,5,8,8,2,2,4,3,1,1,
};

// REAR_MID: 138 Bytes
static const uint8_t PIECE_REAR_MID[] PROGMEM = {
  21,1,20,0,21,0,21,0,21,0,21,0,21,0,1,1,5,10,2,2,17,4,10,11,0,1,9,11,
  0,1,16,4,21,21,21,21,21,21,21,21,21,21,21,21,21,21,21,21,21,21,0,14,7,21,21,21,
  21,21,0,21,21,21,21,21,21,21,21,21,21,21,21,21,21,21,21,21,21,21,21,21,21,21,21,21,
  21,21,21,21,21,21,21,21,21,21,21,21,21,21,21,21,21,21,21,21,21,21,21,21,21,21,21,21,
  21,21,21,21,21,21,21,21,21,21,21,0,21,21,21,21,21,21,21,21,21,21,21,21,21,21,
};

// FRONT_SIDE: 929 Bytes
static const uint8_t PIECE_FRONT_SIDE[] PROGMEM = {
  5,8,8,2,2,4,3,2,5,2,1,1,1,3,8,2,2,4,3,2,5,2,1,1,1,3,8,2,
  2,4,3,1,1,5,2,1,1,1,3,8,2,2,4,3,2,5,2,1,1,1,3,8,2,2,4,3,
  2,5,2,1,1,1,3,8,2,2,4,3,2,5,2,1,1,1,3,8,2,2,4,3,2,5,2,1,
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  26,8,32,2,34,
};

// FRONT_MID: 160 Bytes
static const uint8_t PIECE_FRONT_MID[] PROGMEM = {
  21,21,21,21,21,21,21,21,0,1,20,0,21,21,21,21,21,21,21,21,21,21,21,0,1,20,0,6,
  15,0,21,4,17,15,6,21,21,21,21,21,21,21,21,21,21,21,21,21,21,21,21,21,21,21,21,21,
  21,21,21,21,21,21,21,21,21,0,3,18,0,15,6,0,21,0,21,0,21,2,19,11,10,5,3,13,
  5,3,13,5,3,13,5,2,14,21,21,21,21,21,21,21,21,21,21,21,21,21,21,21,21,21,21,21,
  21,21,21,21,21,21,21,21,21,21,21,21,21,21,21,21,21,21,21,21,21,21,21,21,21,21,21,21,
  0,1,20,0,9,12,0,21,0,21,0,21,0,21,0,21,0,21,5,16,
};

// Linke Silhouettenkante je Zeile (255 = leer); rechte Kante = 108 - Kante
static const uint8_t CAR_EDGE[] PROGMEM = {
  255,22,15,12,11,10,10,9,9,9,9,9,8,8,8,8,8,7,7,7,7,7,6,6,6,6,6,6,
  6,6,6,5,5,5,5,5,5,5,5,5,4,4,4,4,4,4,4,4,4,4,4,4,4,4,4,4,
  4,4,5,5,5,5,5,6,6,6,6,5,5,5,5,5,5,5,5,5,5,5,5,5,5,5,5,5,
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  10,10,11,11,13,14,16,18,20,23,26,32,
};

struct CarPiece {
  const uint8_t *rle;
  uint8_t w;
  uint8_t y0, h;
};

static const CarPiece CAR_PIECES[4] = {
  { PIECE_REAR_SIDE,  34, 0,   114 },
  { PIECE_REAR_MID,   21, 0,   114 },
  { PIECE_FRONT_SIDE, 34, 114, 122 },
  { PIECE_FRONT_MID,  21, 114, 122 },
};

static void drawCarPiece(Adafruit_GFX &d, const CarPiece &p, uint8_t xOff, bool mirror, uint16_t color) {
  const uint8_t *q = p.rle;
  for (uint8_t row = 0; row < p.h; ++row) {
    int16_t y = CAR_OFFSET_Y + (p.y0 + row) * CAR_S;
    uint8_t x = 0;
    bool black = false;
    while (x < p.w) {
      uint8_t n = pgm_read_byte(q++);
      if (black && n) {
        uint8_t px = mirror ? (xOff + p.w - x - n) : (xOff + x);
        d.writeFillRect(CAR_OFFSET_X + px * CAR_S, y, n * CAR_S, CAR_S, color);
      }
      x += n;
      black = !black;
    }
  }
}

// Zeichnet NUR die angegebene Zone (0..5).
static void drawCarZone(Adafruit_GFX &d, uint8_t zone, bool filled,
                        uint16_t fillColor, uint16_t lineColor, uint16_t bgColor) {
  if (zone > 5) return;
  bool front = zone < 3;
  uint8_t col = zone % 3;
  const CarPiece &side = CAR_PIECES[front ? 2 : 0];
  const CarPiece &mid  = CAR_PIECES[front ? 3 : 1];

  uint8_t zx0 = (col == 0) ? 0 : (col == 1) ? CAR_X1 : CAR_X2;
  uint8_t zx1 = (col == 0) ? CAR_X1 : (col == 1) ? CAR_X2 : CAR_WH;

  d.startWrite();
  d.writeFillRect(CAR_OFFSET_X + zx0 * CAR_S, CAR_OFFSET_Y + side.y0 * CAR_S,
                  (zx1 - zx0) * CAR_S, side.h * CAR_S, bgColor);
  if (filled) {
    for (uint8_t row = 0; row < side.h; ++row) {
      uint8_t y = side.y0 + row;
      uint8_t e = pgm_read_byte(&CAR_EDGE[y]);
      if (e == 255) continue;
      uint8_t s = (e > zx0) ? e : zx0;
      uint8_t t = CAR_WH - e;                 // exklusive rechte Kante
      if (t > zx1) t = zx1;
      if (t > s)
        d.writeFillRect(CAR_OFFSET_X + s * CAR_S, CAR_OFFSET_Y + y * CAR_S,
                        (t - s) * CAR_S, CAR_S, fillColor);
    }
  }
  if (col == 0)      drawCarPiece(d, side, 0, false, lineColor);
  else if (col == 2) drawCarPiece(d, side, CAR_WH - side.w, true, lineColor);
  else {
    drawCarPiece(d, mid, CAR_X1, false, lineColor);
    drawCarPiece(d, mid, CAR_X2 - mid.w, true, lineColor);
  }
  d.endWrite();
}

#endif
